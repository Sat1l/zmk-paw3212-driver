## Kconfig
```kconfig
# Sensor data simulator
#
# Copyright (c) 2019 Nordic Semiconductor
#
# SPDX-License-Identifier: LicenseRef-Nordic-5-Clause
#

menuconfig PAW3212
  bool "PAW3212 mouse optical sensor"
  select SPI
  depends on INPUT
  depends on DT_HAS_PIXART_PAW3212_ENABLED
  help
      Enable PAW3212 mouse optical sensor.

if PAW3212

config INPUT_PAW3212_INIT_PRIORITY
    int "PAW3212 initialization priority"
    default INPUT_INIT_PRIORITY

config PAW3212_ORIENTATION_90
  bool "PAW3212 sensor 90 degree rotation"

config PAW3212_ORIENTATION_180
  bool "PAW3212 sensor 180 degree rotation"

config PAW3212_ORIENTATION_270
  bool "PAW3212 sensor 270 degree rotation"

config PAW3212_12_BIT_MODE
  bool "PAW3212 12-bit mode"
  help
    Enable 12-bit reporting mode for increased accuracy.
    When disabled, sensor uses 8-bit mode.

module = PAW3212
module-str = PAW3212
source "${ZEPHYR_BASE}/subsys/logging/Kconfig.template.log_config"

endif #PAW3212
endif #PMW3610
```
